/*
 * Copyright (c) 2022 The ZMK Contributors
 *
 * SPDX-License-Identifier: MIT
 */

&nice_view_spi {
    status = "okay";
    nice_view: ls0xx@0 {
        compatible = "sharp,ls0xx";
        spi-max-frequency = <1000000>;
        reg = <0>;
        width = <144>;
        height = <168>;
        /* Required on Zephyr 4.1+ LS0XX driver when EXTCOMIN is unused.
         * Without this the panel sits DC-biased and appears blank.
         * Matches zmkfirmware/zmk#3294 for upstream nice_view. */
        serial-vcom-inversion;
        serial-vcom-interval = <33>;
    };
};

/ {
    chosen {
        zephyr,display = &nice_view;
    };
};
